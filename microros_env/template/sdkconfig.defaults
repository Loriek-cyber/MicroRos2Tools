## microros_env/template/sdkconfig.defaults
```kconfig
# micro-ROS configuration
CONFIG_MICROROS_TRANSPORT_UDP=y
CONFIG_MICROROS_AGENT_IP="192.168.1.100"
CONFIG_MICROROS_AGENT_PORT="8888"

# FreeRTOS configuration
CONFIG_FREERTOS_HZ=1000

# ESP32 configuration
CONFIG_ESP_MAIN_TASK_STACK_SIZE=20000
CONFIG_ESP_SYSTEM_EVENT_TASK_STACK_SIZE=4096

# Wi-Fi configuration
CONFIG_ESP_WIFI_SSID="Wokwi-GUEST"
CONFIG_ESP_WIFI_PASSWORD=""
```
